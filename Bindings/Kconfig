## Bindings/Kconfig
```kconfig
config DRM_PANEL_OLIMEX_LCD_OLINUXINO
	tristate "Olimex LCD-OLinuXino panel"
	depends on OF
	depends on I2C
	depends on BACKLIGHT_CLASS_DEVICE
	help
	  Say Y here if you want to enable support for Olimex Ltd.
	  LCD-OLinuXino panel. The panel is used with different sizes LCDs,
	  from 480x272 to 1280x800, and 24 bit per pixel.
```
